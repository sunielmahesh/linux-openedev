## drivers/staging/rtl8822cs/Kconfig
```kconfig
# SPDX-License-Identifier: GPL-2.0
config RTL8822CS
	tristate "Realtek RTL8822CS SDIO Wireless LAN NIC driver"
	depends on WLAN && MMC && CFG80211
	depends on m
	select WIRELESS_EXT
	select WEXT_PRIV
	select RTL8822CS_CORE
	select RTL8822CS_OS
	select RTL8822CS_HAL
	help
	  This option enables support for RTL8822CS SDIO drivers, such as
	  the wifi found on the 1st gen Intel Compute Stick, the CHIP
	  and many other Intel Atom and ARM based devices.
	  If built as a module, it will be called r8822cs.

if RTL8822CS

config SDIO_HCI
	tristate

config MP_INCLUDED
	tristate

source "drivers/staging/rtl8822cs/core/Kconfig"
source "drivers/staging/rtl8822cs/os_dep/Kconfig"
source "drivers/staging/rtl8822cs/hal/Kconfig"

endif # RTL8822CS
```

## drivers/staging/rtl8822cs/core/Kconfig
```kconfig
menuconfig RTL8822CS_CORE
	tristate "RTL8822CS CORE"
	select RTL8822CS_CORE_DRV
	help
	  RTL8822CS Core.

if RTL8822CS_CORE

config RTL8822CS_CORE_DRV
	tristate "RTL8822CS CORE Core drivers"
	select SDIO_HCI
	select MP_INCLUDED
	help
	  RTL8822CS CORE core drivers.

endif # RTL8822CS_CORE
```

## drivers/staging/rtl8822cs/hal/Kconfig
```kconfig
menuconfig RTL8822CS_HAL
	tristate "RTL8822CS HAL drivers"
	select RTL8822CS_HAL_DRV
	help
	  RTL8822CS HAL drivers.

if RTL8822CS_HAL

config RTL8822CS_HAL_DRV
	tristate "RTL8822CS HAL Core drivers"
	select SDIO_HCI
	select MP_INCLUDED
	help
	  RTL8822CS HAL core drivers.

endif # RTL8822CS_HAL
```

## drivers/staging/rtl8822cs/os_dep/Kconfig
```kconfig
menuconfig RTL8822CS_OS
	tristate "RTL8822CS OS drivers"
	select RTL8822CS_OS_DRV
	help
	  RTL8822CS OS drivers.

if RTL8822CS_OS

config RTL8822CS_OS_DRV
	tristate "RTL8822CS OS Core drivers"
	select SDIO_HCI
	select MP_INCLUDED
	help
	  RTL8822CS OS core drivers.

endif # RTL8822CS_OS
```
